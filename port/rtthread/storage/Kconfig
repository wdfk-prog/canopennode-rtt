## port/rtthread/storage/Kconfig
```kconfig
# Kconfig file for CANopenNode RT-Thread storage backends.

choice
    prompt "CANopenNode RT-Thread storage implementation"
    default PKG_CANOPENNODE_USING_STORAGE_DFS if RT_USING_DFS
    default PKG_CANOPENNODE_USING_STORAGE_EEPROM if PKG_USING_AT24CXX
    default PKG_CANOPENNODE_USING_STORAGE_USER
    help
        Select exactly one storage implementation. DFS and EEPROM build the
        package-provided RT-Thread backends under port/rtthread/storage. The user
        implementation builds only the storage frontend and requires the
        application to provide a strong co_storage_rtt_backend_get_ops() symbol.

config PKG_CANOPENNODE_USING_STORAGE_DFS
    bool "Use built-in RT-Thread DFS storage backend"
    depends on RT_USING_DFS
    select PKG_CANOPENNODE_USING_CRC16
    help
        Build the default RT-Thread DFS backend for CANopenNode storage.
        The backend uses native dfs_file_* APIs with local DFS open-flag
        values and stores each CO_storage_entry_t payload with a small header,
        length field and CRC16 checksum. co_storage_rtt_init() reads existing
        files after CO_storage_init() has registered OD 0x1010 and 0x1011
        callbacks. This option does not require DFS_USING_POSIX.

        The default DFS backend is not power-loss safe. Products that require
        fail-safe parameter storage should use the EEPROM backend or a custom
        backend with atomic commit/rollback semantics.

        If ENOENT is available from the C library, the read path treats only a
        missing file as first startup and reports other open failures. If ENOENT
        is unavailable, DFS cannot reliably distinguish a missing file from
        another open error, so it logs the path and return code and preserves the
        previous first-startup behavior. Store and restore failures include
        path-level diagnostics when debug logging is enabled.

        The default app wrapper does not keep a RAM copy of OD_PERSIST_*
        factory defaults. The DFS restore hook removes the persisted file
        only; generated OD defaults take effect after the stack/application is
        recreated and no persisted file is read.

config PKG_CANOPENNODE_USING_STORAGE_EEPROM
    bool "Use built-in EEPROM storage backend"
    depends on PKG_USING_AT24CXX
    depends on PKG_CANOPENNODE_CAN_BINDING_COUNT = 1
    select PKG_CANOPENNODE_USING_CRC16
    help
        Build the EEPROM backend for CANopenNode storage. This backend reuses
        CANopenNode/storage/CO_storageEeprom.c, adds the EEPROM fields to
        CO_storage_entry_t, and uses the built-in AT24CXX device adapter to
        provide the CO_eeprom_* target hooks. The built-in AT24CXX adapter is
        intentionally limited to one CANopenNode instance because it owns one
        EEPROM region configured by PKG_CANOPENNODE_STORAGE_AT24C_OFFSET and
        PKG_CANOPENNODE_STORAGE_AT24C_REGION_SIZE.

config PKG_CANOPENNODE_USING_STORAGE_USER
    bool "Use user-provided storage backend"
    help
        Build only the common RT-Thread storage frontend under
        port/rtthread/storage and let the application provide the actual backend.
        The application must provide a strong co_storage_rtt_backend_get_ops()
        symbol that returns a permanent CO_storage_rtt_backend_ops_t table with
        init, read, store and restore callbacks. This is the intended option for
        board-specific flash, filesystem, NVM or fail-safe storage.

endchoice

if PKG_CANOPENNODE_USING_STORAGE_EEPROM

config PKG_CANOPENNODE_USING_STORAGE_AT24C
    bool
    default y
    depends on PKG_USING_AT24CXX
    help
        Use the RT-Thread AT24CXX package as the EEPROM device implementation.
        The package must provide at24cxx_init(), at24cxx_read(), at24cxx_write(),
        AT24CXX_MAX_MEM_ADDRESS and AT24CXX_PAGE_BYTE.

config PKG_CANOPENNODE_STORAGE_AT24C_I2C_BUS_NAME
    string "AT24CXX I2C bus name"
    default "i2c1"
    depends on PKG_CANOPENNODE_USING_STORAGE_AT24C
    help
        RT-Thread I2C bus name passed to at24cxx_init(). The bus and AT24CXX
        package must be initialized before CANopen storage initialization.

config PKG_CANOPENNODE_STORAGE_AT24C_ADDR_INPUT
    int "AT24CXX address input"
    range 0 7
    default 0
    depends on PKG_CANOPENNODE_USING_STORAGE_AT24C
    help
        Address-input value passed as AddrInput to at24cxx_init(). The supplied
        RT-Thread AT24CXX adapter uses 7-bit base address 0x50 OR AddrInput.
        Keep the generic default unless board wiring requires another address.
        Set AddrInput to 1 explicitly when the EEPROM must use address 0x51.

config PKG_CANOPENNODE_STORAGE_AT24C_OFFSET
    int "AT24CXX storage region start offset"
    range 0 2147483647
    default 0
    depends on PKG_CANOPENNODE_USING_STORAGE_AT24C
    help
        First EEPROM byte reserved for CANopenNode storage. Configure this with
        PKG_CANOPENNODE_STORAGE_AT24C_REGION_SIZE so the complete region
        [OFFSET, OFFSET + REGION_SIZE) does not overlap bootloader or application
        EEPROM data.

config PKG_CANOPENNODE_STORAGE_AT24C_REGION_SIZE
    int "AT24CXX storage reserved region size (0 = remaining EEPROM)"
    range 0 2147483647
    default 0
    depends on PKG_CANOPENNODE_USING_STORAGE_AT24C
    help
        Number of EEPROM bytes reserved exclusively for CANopenNode storage.
        Set a non-zero value when the EEPROM is shared with the bootloader or
        application so all CO_storageEeprom and raw diagnostic access is bounded
        to [OFFSET, OFFSET + REGION_SIZE). Value 0 preserves legacy behavior and
        uses all physical EEPROM bytes from OFFSET to the end of the device.

config PKG_CANOPENNODE_STORAGE_AT24C_CRC_BUF_SIZE
    int "AT24CXX CRC read buffer size"
    range 8 256
    default 32
    depends on PKG_CANOPENNODE_USING_STORAGE_AT24C
    help
        Temporary stack buffer size used while calculating CRC over EEPROM data.

endif

config PKG_CANOPENNODE_LSS_PERSIST
    bool "Persist LSS Node-ID and bitrate"
    default n
    depends on PKG_CANOPENNODE_USING_STORAGE
    depends on PKG_CANOPENNODE_USING_LSS_SLAVE
    select PKG_CANOPENNODE_USING_CRC16
    help
        Persist the LSS pending Node-ID and bitrate through the selected RT-Thread
        storage backend. The application loads the record after storage backend
        initialization and before the first CO_CANinit(). Communication Reset
        keeps the current in-RAM pending values and does not reload persistence.

        Built-in backends provide a dedicated auxiliary persistence area that is
        separate from normal CO_storage_entry_t payloads. A user-provided backend
        must implement aux_read and aux_write in CO_storage_rtt_backend_ops_t.

        The single-slot record uses CRC and a commit marker written last. An
        erased, invalid, or interrupted record is ignored and startup falls back
        to the configured Node-ID and bitrate. This option does not register the
        LSS Store callback or perform runtime bitrate activation by itself.

config PKG_CANOPENNODE_STORAGE_DFS_DIR
    string "CANopen DFS storage directory"
    default "/flash/canopen"
    depends on PKG_CANOPENNODE_USING_STORAGE_DFS
    help
        Default directory used by the RT-Thread DFS backend. The directory
        path must not end with '/'. The default app wrapper uses the CAN device
        name as a filename prefix so multiple instances do not share the same
        storage file. The backend does not create directories; mount points and
        storage directories must already exist.

config PKG_CANOPENNODE_STORAGE_DFS_MAX_PATH
    int "CANopen DFS storage maximum path length"
    range 32 512
    default 128
    depends on PKG_CANOPENNODE_USING_STORAGE_DFS
    help
        Size in bytes of the temporary stack buffer used to build storage file
        paths. Increase it when the configured directory is long.
```

## profile/Kconfig
```kconfig
# Kconfig entry for CANopen device profiles.

menu "CANopen profiles"

config PKG_CANOPENNODE_PROFILE_REGISTRY
    bool "Enable common logical-device profile registry"
    default n
    help
        Build the Pure-C fixed-capacity registry that validates one CANopen
        node's logical-device slot ownership against generated Device Type
        entries. The registry uses no heap, RT-Thread, BSP, HAL, or concrete
        Device Profile dependency.

rsource "cia401/Kconfig"
rsource "cia402/Kconfig"
rsource "mixed/Kconfig"

config PKG_CANOPENNODE_PROFILE_RTT_SHARED_WORKER
    bool
    default y if PKG_CANOPENNODE_CIA401_DEVICE_RTT_THREAD && !PKG_CANOPENNODE_CIA401_DEVICE_RTT_DEDICATED_WORKER
    default y if PKG_CANOPENNODE_CIA402_DEVICE_RTT_THREAD && !PKG_CANOPENNODE_CIA402_DEVICE_RTT_DEDICATED_WORKER
    help
        Internal derived switch for the common deferred lifecycle worker used by
        Device Profiles that did not request a dedicated RT-Thread worker.

if PKG_CANOPENNODE_PROFILE_RTT_SHARED_WORKER

menu "Shared RT-Thread profile worker"

config PKG_CANOPENNODE_PROFILE_THREAD_STACK_SIZE
    int "Stack size"
    default 2048
    help
        Stack size in bytes for the common co_prof worker. Profile callbacks run
        sequentially, so size this for the deepest enabled shared Profile pass,
        not the sum of all Profile stack sizes. Confirm the final margin on target.

config PKG_CANOPENNODE_PROFILE_THREAD_PRIORITY
    int "Priority"
    default 5
    help
        RT-Thread priority for the common co_prof worker. Lower numeric values are
        higher priority. It must remain numerically greater than co_rt priority.
        A Profile requiring stronger isolation should enable its dedicated-worker
        option instead of increasing this shared priority arbitrarily.

endmenu

endif

endmenu
```

## profile/cia401/Kconfig
```kconfig
# Kconfig entry for the CiA 401 generic I/O device profile.

menuconfig PKG_CANOPENNODE_CIA401
    bool "CiA 401 generic I/O device profile"
    default n
    help
        Enable role-neutral CiA 401 definitions. Stage 1 contains only the
        Pure-C local Device process image and generated-OD contract; it does not
        add RT-Thread, heap, hardware-driver, event-mask, scaling or fault-safe
        dependencies.

if PKG_CANOPENNODE_CIA401

rsource "device/Kconfig"

endif
```

## profile/cia401/device/Kconfig
```kconfig
# Kconfig for the Pure-C local CiA 401 Device core.

config PKG_CANOPENNODE_CIA401_DEVICE
    bool "Local CiA 401 Device core"
    default y
    depends on PKG_CANOPENNODE_CIA401
    help
        Build the Pure-C generic I/O Device core for Objects 0x6000, 0x6200,
        0x6401 and 0x6411. Generated OD objects are validated against product
        capability counts before any process-image exchange is enabled.

if PKG_CANOPENNODE_CIA401_DEVICE

config PKG_CANOPENNODE_CIA401_DIGITAL_EVENTS
    bool "CiA 401 digital input events and filter bridge"
    default n
    depends on PKG_CANOPENNODE_TPDO
    depends on PKG_CANOPENNODE_PDO_OD_IO_ACCESS
    help
        Enable Objects 0x6002, 0x6003 and 0x6005..0x6008, logical edge
        detection, OD-based TPDO event requests and the product filter-enable
        bridge. OD_FLAGS_PDO_SIZE must cover every enabled 0x6000 sub-index.

config PKG_CANOPENNODE_CIA401_DIGITAL_OUTPUT_FAILSAFE
    bool "CiA 401 digital output profile semantics"
    default n
    depends on PKG_CANOPENNODE_RPDO
    depends on PKG_CANOPENNODE_PDO_OD_IO_ACCESS
    help
        Enable Objects 0x6202, 0x6206, 0x6207 and 0x6208, including output
        polarity, final physical-output filtering and fail-safe physical output
        selection. The product IOIF must provide masked physical writes so 0x6206
        keep bits and 0x6208 blocked bits are never overwritten. The 0x6200 command
        image always retains the complete received value.

endif
```

## profile/cia402/demo/Kconfig
```kconfig
# Kconfig for the package-provided CiA 402 RT-Thread demo factory.

menu "Demo"

config PKG_CANOPENNODE_CIA402_DEVICE_RTT_DEMO
    bool "Enable RT-Thread CiA 402 Device demo"
    default n
    depends on PKG_CANOPENNODE_CIA402_DEVICE_RTT_THREAD
    depends on PKG_CANOPENNODE_APP_AUTO_INIT
    depends on RT_USING_COMPONENTS_INIT
    depends on RT_USING_HEAP
    select PKG_CANOPENNODE_CIA402_DEVICE_RTT_AUTOSTART
    select PKG_CANOPENNODE_USING_DEMO_OD
    help
        Register the package-provided software-only CiA 402 Device factory for
        the default CANopenNodeRTT application. PDS transitions complete without
        hardware; PP/HM expose one BUSY interval before deterministic completion,
        while PV updates software feedback from the live command. The demo uses
        logical devices 0..N-1 from the generated demo Object Dictionary and never
        controls a physical motor or power stage. Enable CANopen debug + RT-Thread
        ULOG to print the simulated PDS and PP/PV/HM actions.

if PKG_CANOPENNODE_CIA402_DEVICE_RTT_DEMO

config PKG_CANOPENNODE_CIA402_DEMO_AXIS_COUNT
    int "Demo logical device count"
    range 1 3
    default 3
    help
        Number of package demo axes to register. The generated demo Object
        Dictionary provides logical devices 0, 1 and 2, so this option is
        intentionally limited to 1..3.

endif

endmenu
```

## profile/cia402/device/Kconfig
```kconfig
# Kconfig for the Pure-C local CiA 402 Device core.

config PKG_CANOPENNODE_CIA402_DEVICE
    bool "Local CiA 402 Device core"
    default y
    help
        Build the Pure-C local Device manager, generated-OD binding and PDS
        supervisor. This layer has no RT-Thread/BSP dependency and allocates no
        axis storage dynamically.

config PKG_CANOPENNODE_CIA402_DEVICE_MODE_PP
    bool "Profile Position (PP) mode"
    default y
    depends on PKG_CANOPENNODE_CIA402_DEVICE
    help
        Build the Pure-C Profile Position supervisor. An axis advertises PP only
        when its DriveIF provides mode entry/exit and profilePosition callbacks;
        only then are the PP-specific OD objects required during binding.

config PKG_CANOPENNODE_CIA402_DEVICE_MODE_PV
    bool "Profile Velocity (PV) mode"
    default y
    depends on PKG_CANOPENNODE_CIA402_DEVICE
    help
        Build the Pure-C Profile Velocity supervisor. An axis advertises PV only
        when its DriveIF provides mode entry/exit and profileVelocity callbacks;
        only then are the PV-specific OD objects required during binding.

config PKG_CANOPENNODE_CIA402_DEVICE_MODE_HM
    bool "Homing (HM) mode"
    default y
    depends on PKG_CANOPENNODE_CIA402_DEVICE
    help
        Build the Pure-C Homing supervisor. An axis advertises HM only when its
        DriveIF provides mode entry/exit and homing callbacks; only then are the
        homing-specific OD objects required during binding.
```
